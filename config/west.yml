## config/west.yml
```yaml
manifest:
  remotes:
    - name: zmkfirmware
      url-base: https://github.com/zmkfirmware
    - name: dhruvinsh
      url-base: https://github.com/dhruvinsh
    - name: urob
      url-base: https://github.com/urob
  projects:
    - name: zmk
      remote: zmkfirmware
      revision: main
      import: app/west.yml
    - name: zmk-tri-state
      remote: dhruvinsh
      revision: ebbc1f0ccdb51669650bb0ac3e34920d09e62400  # pinned 2025-03-16
    - name: zmk-auto-layer
      remote: urob
      revision: 62c201934711369d50a28df12e1d055d05cb6460  # pinned 2026-05-21 (num_word)
  self:
    path: config
```
